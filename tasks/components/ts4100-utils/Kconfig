## tasks/components/ts4100-utils/Kconfig
```kconfig
config DS_COMPONENT_TS4100_UTILS
	bool "ts4100-utils"
	select DS_COMPONENT_ZPU_ARMHF
	help
	  Utilities tools for TS-4100 SoM

	  Includes tools to communicate with the supervisory
	  microcontroller, TS-SILO monitor script, interface to FPGA,
	  and ZPU utilities
```

## tasks/components/ts7180-utils/Kconfig
```kconfig
config DS_COMPONENT_TS7180_UTILS
	bool "ts7180-utils"
	help
	  This set of utils is for the TS-7180 includes tools for checking
	  board versions, etc.
```

## tasks/components/ts7680-utils/Kconfig
```kconfig
config DS_COMPONENT_TS7680_UTILS
	bool "ts7680-utils"
	help
	  Userspace utilities for controlling various aspects of the on-board
	  microcontroller and other platform information.
```

## tasks/components/tsmicroctl/Kconfig
```kconfig
comment "tsmicroctl is not compatible with the selected platform utilities"
	depends on (DS_COMPONENT_TS4100_UTILS || DS_COMPONENT_TS4900_UTILS || \
			    DS_COMPONENT_TS7400V2_UTILS || DS_COMPONENT_TS7553V2_UTILS || \
			    DS_COMPONENT_TS7670_UTILS || DS_COMPONENT_TS7680_UTILS)
config DS_COMPONENT_TSMICROCTL
	bool "tsmicroctl"
	depends on !(DS_COMPONENT_TS4100_UTILS || DS_COMPONENT_TS4900_UTILS || \
				 DS_COMPONENT_TS7400V2_UTILS || DS_COMPONENT_TS7553V2_UTILS || \
				 DS_COMPONENT_TS7670_UTILS || DS_COMPONENT_TS7680_UTILS)
	help
	  This utility is for the TS-7100, TS-7180, TS-7800-V2 for controlling
          the onboard microcontroller.
```

## tasks/components/tssilomon-service/Kconfig
```kconfig
config DS_TSSILOMON_SERVICE
	bool "Install tssilomon systemd startup script"
	help
          The TS products that offer TS-SILO supercapacitor support
          will have a monitor daemon as part of their utilities
          repository.

          By default, the script is installed but does not have a
          startup process. Enabling this will add a systemd style
          script to start and stop the daemon.
```

## tasks/components/tssupervisorupdate/Kconfig
```kconfig
config DS_COMPONENT_TSSUPERVISORUPDATE
	bool "tssupervisorupdate"
	help
	  This project is used to update the supervisory microcontroller on
	  embeddedTS products. This supports the TS-7250-V3, TS-7970, all
          i.MX93-based products, and more in the future.
```

## tasks/components/wilc3000-external-module/Kconfig
```kconfig
config DS_MODULE_WILC3000
	bool "wilc3000-module"
	help
	  This module provides the drivers from Microchip's linux4microchip git

config DS_MODULE_WILC3000_GIT_VERSION
	string "wilc3000-module GIT srcrev"
	help
	  Specify tag or branch to checkout before building.
```

## tasks/core/Kconfig
```kconfig
### Default CONFIG options enabled all the time
config DS_CORE_CLEAN_WORK
    bool
    default "y"
config DS_CORE_CREATE_WORK
    bool
    default "y"
config DS_CORE_BUILD_VM
    bool
    default "y"
config DS_CORE_VM_READY
    bool
    default "y"
config DS_CORE_PACKAGELIST_CROSS_PREP
    bool
    default "y"
config DS_CROSS_READY
    bool
    default "y"
config DS_TARGET_LOCAL_PACKAGES
    bool
    default "y"
config DS_TARGET_CHROOT_PREP
    bool
    default "y"
config DS_TARGET_APT_CONFIGURED
    bool
    default "y"
config DS_TARGET_CHROOT_CLEAN
    bool
    default "y"
config DS_TARGET_CHROOT_LATE
    bool
    default "y"
config DS_TARGET_ROOTFS_IDENTIFIABLE
    bool
    default "y"
config DS_SET_TEMPORARY_RESOLV
    bool
    default "y"
config DS_TARGET_CHROOT_READY
    bool
    default "y"
config DS_TARGET_ROOTFS_READY
    bool
    default "y"
config DS_CORE_MULTISTRAP_CONF
    bool
    default "y"
config DS_CORE_PACKAGELIST
    bool
    default "y"
config DS_TARGET_IMAGES_READY
    bool
    default "y"
config DS_CORE_PACKAGELIST_PREP
    bool
    default "y"
config DS_TARGET_PACKAGELIST_EXTRA
    bool
    default "y"
config DS_TARGET_LATE_PACKAGES_INSTALL
    bool
    default "y"

# This task is never enabled. This task is only invoked form clean-cache.py,
# but this definition silences the warning from this manifest not finding
# matching Kconfig symbol.
config DS_CORE_CLEAN_CACHE
    bool
    default "n"
```

## tasks/core/rootfs_identification/Kconfig
```kconfig
config DS_TARGET_ROOTFS_IDENTIFIABLE
	bool "make rootfs identifiable"
	help
	  Create root.version and md5sums for checking this image
```

## tasks/image_output/genimage/Kconfig
```kconfig
config DS_GENIMAGE
    bool "Create image with genimage"
    help
      Generates a disk image from a config file and the other generated files

config DS_GENIMAGE_PATH
    string "Path to genimage config file"
    depends on DS_GENIMAGE
    help
      Path relative to distro-seed to the genimage config file

if  DS_GENIMAGE
choice
        prompt "Disk image compression format"
        default DS_GENIMAGE_XZ

config DS_GENIMAGE_NONE
        bool "No compression"

config DS_GENIMAGE_XZ
        bool "xz compression"

config DS_GENIMAGE_BZIP2
        bool "bz2 compression"

endchoice
endif
```

## tasks/image_output/sbom/Kconfig
```kconfig
config DS_OUTPUT_SBOM
	bool "SPDX SBOM"
	default y
	help
	  Generate SPDX JSON SBOM files for final output artifacts using debsbom.
```

## tasks/kernel/Kconfig
```kconfig
menu "Kernel"

choice
	prompt "Kernel version"
	default DS_KERNEL_PROVIDER_GIT

config DS_KERNEL_PROVIDER_GIT
	bool "Kernel source provider is custom git repository"
	help
	  This option allows distro-seed to grab the kernel sources from git

endchoice

if DS_KERNEL_PROVIDER_GIT
config DS_KERNEL_PROVIDER_GIT_URL
	string "URL of git repository"
	help
	  Specify git repo to fetch kernel. This can be specified as:
	  git://path/to/repo.git
	  https://path/to/repo.git
	  /path/to/locally/cloned/kernel/git/

config DS_KERNEL_PROVIDER_GIT_VERSION
	string "Kernel GIT srcrev"
	help
	  Specify tag or branch to checkout before building.
	  This is optional if the provider git url points to a local path.
endif

config DS_KERNEL_DEFCONFIG
	string "Kernel defconfig"
	help
	  Specify kernel defconfig to use

config DS_KERNEL_INSTALL_DEVICETREE_FILESYSTEM
	string "Stems of device tree file paths to install in /boot"
	help   
	  Device tree names to install on the target, eg:
	  foo/bar
	  would take foo/bar.dtb (built under kernel target linux-dtbs)
          and install it to /boot/bar.dtb

config DS_KERNEL_INSTALL_DTBOS_FILESYSTEM
	string "Stems of device tree overlay file paths to install in /boot"
	help
	  Device tree overlay names to install on the target, eg:
	  foo/bar
	  would take foo/bar.dtbo (built under kernel target linux-dtbs)
          and install it to /boot/bar.dtbo

config DS_KERNEL_INSTALL_IMAGE_FILESYSTEM
	depends on DS_ARCH_AARCH64
	default y
	bool "Install Image to the target filesystem in /boot/Image"

config DS_KERNEL_INSTALL_ZIMAGE_FILESYSTEM
	depends on DS_ARCH_ARMHF || DS_ARCH_ARMEL
	bool "Install zImage to the target filesystem in /boot/"

config DS_KERNEL_INSTALL_UIMAGE_FILESYSTEM
	depends on DS_ARCH_ARMHF || DS_ARCH_ARMEL
	bool "Install legacy uImage to the target filesystem in /boot/"

config DS_KERNEL_INSTALL_UIMAGE_LOADADDR
	hex "uImage Loadaddr"
	depends on DS_KERNEL_INSTALL_UIMAGE_FILESYSTEM
	help
	  Specify the load address for the kernel. This is required for the
	  uImage kernel format.  This is usually found in the target's U-Boot
	  from:  "env print loadaddr" or "env print kernel_addr_r"

endmenu
```
