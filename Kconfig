## Kconfig
```kconfig
menu "Build Options"
config DS_DEFCONFIG
	string "Location to save defconfig"
	default ""
endmenu

source "tasks/Kconfig"

osource "$(DS_EXTERNAL)/Kconfig"
```

## configs/virtarm64_debian_12_headless_defconfig
```kconfig
CONFIG_DS_ARCH_AARCH64=y
CONFIG_DS_DISTRO_DEBIAN_12=y
CONFIG_DS_PACKAGELIST="debian_12_headless.txt"
CONFIG_DS_KERNEL_PROVIDER_DEBIAN_PACKAGE=y
CONFIG_DS_KERNEL_DEBIAN_PACKAGE_NAME="linux-image-arm64"
CONFIG_DS_COMPONENT_RESIZE=y
CONFIG_DS_USER_ROOT_EN=y
CONFIG_DS_PURGE_LOCALES=y
CONFIG_DS_HOSTNAME="virtarm64"
CONFIG_DS_INITRAMFS_MODULES="virtio_blk"
CONFIG_DS_OUTPUT_ROOTFS_TAR=y
CONFIG_DS_OUTPUT_ROOTFS_EXT=y
CONFIG_DS_OUTPUT_ROOTFS_EXT_SIZE="6G"
```

## configs/virtarmhf_debian_13_x11_defconfig
```kconfig
CONFIG_DS_DISTRO_DEBIAN_13=y
CONFIG_DS_PACKAGELIST="debian_13_x11.txt"
CONFIG_DS_DISTRO_PACKAGELIST_APPEND="libgl1-mesa-dri"
CONFIG_DS_KERNEL_PROVIDER_DEBIAN_PACKAGE=y
CONFIG_DS_KERNEL_DEBIAN_PACKAGE_NAME="linux-image-armmp"
CONFIG_DS_COMPONENT_RESIZE=y
CONFIG_DS_XORG_STARTX_SERVICE=y
CONFIG_DS_USER_ROOT_EN=y
CONFIG_DS_PURGE_LOCALES=y
CONFIG_DS_HOSTNAME="virtarmhf"
CONFIG_DS_INITRAMFS_MODULES="virtio_blk"
CONFIG_DS_OUTPUT_ROOTFS_TAR=y
CONFIG_DS_OUTPUT_ROOTFS_EXT=y
CONFIG_DS_OUTPUT_ROOTFS_EXT_SIZE="6G"
```

## configs/virtarmhf_ubuntu_24_04_minimal_defconfig
```kconfig
CONFIG_DS_DISTRO_UBUNTU_24_04=y
CONFIG_DS_PACKAGELIST="ubuntu_24.04_minimal.txt"
CONFIG_DS_KERNEL_PROVIDER_DEBIAN_PACKAGE=y
CONFIG_DS_KERNEL_DEBIAN_PACKAGE_NAME="linux-image-generic"
CONFIG_DS_COMPONENT_RESIZE=y
CONFIG_DS_USER_ROOT_EN=y
CONFIG_DS_PURGE_LOCALES=y
CONFIG_DS_HOSTNAME="virtarmhf"
CONFIG_DS_INITRAMFS_MODULES="virtio_blk"
# CONFIG_DS_REGENERATE_COMMAND_NOT_FOUND is not set
# CONFIG_DS_SET_NTPSERVER is not set
CONFIG_DS_OUTPUT_ROOTFS_TAR=y
CONFIG_DS_OUTPUT_ROOTFS_EXT=y
CONFIG_DS_OUTPUT_ROOTFS_EXT_SIZE="6G"
```

## tasks/components/weston-kiosk-service/Kconfig
```kconfig
config DS_WESTON_KIOSK_SERVICE
	bool "Weston kiosk demo service"
	help
	  Run Weston automatically on startup using kiosk shell.

config DS_WESTON_KIOSK_SERVICE_COMMAND
	string "Wayland kiosk command"
	depends on DS_WESTON_KIOSK_SERVICE
	default "/usr/bin/weston-flower"
	help
	  Command to launch after Weston starts.
```

## tasks/image_configuration/initramfs-modules/Kconfig
```kconfig
config DS_INITRAMFS_MODULES
	string "Modules to include and load in the initramfs"
	default ""
	help
	  Space-separated kernel module names required before mounting the root
	  filesystem, for example virtio_blk. Uses initramfs-tools and regenerates
	  existing initramfs images after package installation. The module list
	  is retained for future kernel updates. Empty disables this task.

config DS_SET_INITRAMFS_MODULES
	bool
	default y if DS_INITRAMFS_MODULES != ""
```

## tasks/image_configuration/set-timezone/Kconfig
```kconfig
config DS_SET_TIMEZONE
	bool
	default y

config DS_TIMEZONE
	string "Set System Timezone"
	default "Etc/GMT"
	help
	  Set the timezone on the image.  See timezone from /usr/share/zoneinfo
	  for the list of all timezones.
```

## tasks/image_output/sbom-cyclonedx/Kconfig
```kconfig
config DS_OUTPUT_SBOM_CYCLONEDX
	bool "CycloneDX SBOM"
	default y
	help
	  Generate a CycloneDX JSON SBOM for the final target rootfs using debsbom.
	  The file is written to work/output/<image-name>.cdx.json.
```

## tasks/image_output/vex/Kconfig
```kconfig
config DS_OUTPUT_VEX
	bool "OpenVEX vulnerability report"
	default n
	depends on DS_DISTRO_DEBIAN_11 || DS_DISTRO_DEBIAN_12 || DS_DISTRO_DEBIAN_13
	select DS_OUTPUT_SBOM_CYCLONEDX
	help
	  Scan the CycloneDX SBOM with debsbom using the Debian Security Tracker
	  and write work/output/<image-name>.vex.json. Enables CycloneDX output.
	  This is a separate scan step and downloads current vulnerability data
	  unless a local database is configured below. Only Debian is supported.

config DS_OUTPUT_VEX_AUTHOR
	string "OpenVEX document author"
	depends on DS_OUTPUT_VEX
	default "distro-seed"
	help
	  Author recorded in the generated OpenVEX document.

config DS_OUTPUT_VEX_DATABASE
	string "Local Debian Security Tracker JSON database"
	depends on DS_OUTPUT_VEX
	default ""
	help
	  Optional path visible inside the build VM to an existing Debian
	  Security Tracker JSON database. It must exist and will not be updated.
	  Leave empty to download current data into the shared download directory
	  on every build. Set this to use a fixed database or build offline.
```
