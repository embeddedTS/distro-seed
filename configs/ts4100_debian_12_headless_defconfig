## configs/ts4100_debian_12_headless_defconfig
```kconfig
CONFIG_DS_DISTRO_DEBIAN_12=y
CONFIG_DS_PACKAGELIST="debian_12_headless.txt"
CONFIG_DS_KERNEL_PROVIDER_GIT_URL="https://github.com/embeddedTS/linux-lts.git"
CONFIG_DS_KERNEL_PROVIDER_GIT_VERSION="v6.6.83.1-ts"
CONFIG_DS_KERNEL_DEFCONFIG="tsimx6ul_defconfig"
CONFIG_DS_KERNEL_INSTALL_DEVICETREE_FILESYSTEM="imx6ul-ts4100 imx6ul-ts4100-7 imx6ul-ts4100-8 imx6ul-ts4100-16"
CONFIG_DS_KERNEL_INSTALL_ZIMAGE_FILESYSTEM=y
CONFIG_DS_COMPONENT_TS4100_UTILS=y
CONFIG_DS_TSSILOMON_SERVICE=y
CONFIG_DS_COMPONENT_WILC3000_FIRMWARE=y
CONFIG_DS_MODULE_WILC3000=y
CONFIG_DS_MODULE_WILC3000_GIT_VERSION="linux4microchip-2021.10-1-upto-linux-6.6"
CONFIG_DS_WATCHDOG=y
CONFIG_DS_COMPONENT_RESIZE=y
CONFIG_DS_USER_ROOT_EN=y
CONFIG_DS_PURGE_LOCALES=y
CONFIG_DS_HOSTNAME="tsimx6ul"
CONFIG_DS_TIMEZONE="America/Phoenix"
CONFIG_DS_IMAGE_ROOTFS_TAR=y
```

## configs/ts7180_debian_12_headless_defconfig
```kconfig
CONFIG_DS_DISTRO_DEBIAN_12=y
CONFIG_DS_PACKAGELIST="debian_12_headless.txt"
CONFIG_DS_DISTRO_PACKAGELIST_APPEND="gpsd gpsd-clients pps-tools"
CONFIG_DS_KERNEL_PROVIDER_GIT_URL="https://github.com/embeddedTS/linux-lts.git"
CONFIG_DS_KERNEL_PROVIDER_GIT_VERSION="v5.10.208.1-ts"
CONFIG_DS_KERNEL_DEFCONFIG="tsimx6ul_defconfig"
CONFIG_DS_KERNEL_INSTALL_DEVICETREE_FILESYSTEM="imx6ul-ts7180"
CONFIG_DS_KERNEL_INSTALL_ZIMAGE_FILESYSTEM=y
CONFIG_DS_COMPONENT_TS7180_UTILS=y
CONFIG_DS_COMPONENT_TSSUPERVISORUPDATE=y
CONFIG_DS_COMPONENT_TS_UBOOT_CONFIGS=y
CONFIG_DS_COMPONENT_WILC3000_FIRMWARE=y
CONFIG_DS_MODULE_WILC3000=y
CONFIG_DS_COMPONENT_DISTROBOOT_SCRIPTS=y
CONFIG_DS_COMPONENT_DISTROBOOT_SCRIPTS_INSTALL_SOURCE=y
CONFIG_DS_WATCHDOG=y
CONFIG_DS_COMPONENT_RESIZE=y
CONFIG_DS_USER_ROOT_EN=y
CONFIG_DS_PURGE_LOCALES=y
CONFIG_DS_HOSTNAME="ts7180"
CONFIG_DS_TIMEZONE="America/Phoenix"
CONFIG_DS_IMAGE_ROOTFS_TAR=y
CONFIG_DS_COMPONENT_GPSD_PPS=n
```

## configs/ts7670_debian_12_headless_defconfig
```kconfig
CONFIG_DS_ARCH_ARMEL=y
CONFIG_DS_DISTRO_DEBIAN_12=y
CONFIG_DS_PACKAGELIST="debian_12_headless.txt"
CONFIG_DS_KERNEL_PROVIDER_GIT_URL="https://github.com/embeddedTS/linux-lts.git"
CONFIG_DS_KERNEL_PROVIDER_GIT_VERSION="v6.6.83.1-ts"
CONFIG_DS_KERNEL_DEFCONFIG="tsimx28_defconfig"
CONFIG_DS_KERNEL_INSTALL_DEVICETREE_FILESYSTEM="imx28-ts7670 imx28-ts7400v2"
CONFIG_DS_KERNEL_INSTALL_UIMAGE_FILESYSTEM=y
CONFIG_DS_KERNEL_INSTALL_UIMAGE_LOADADDR=0x40008000
CONFIG_DS_COMPONENT_TS7670_UBOOT=y
CONFIG_DS_COMPONENT_TS7670_UTILS=y
CONFIG_DS_WATCHDOG=y
CONFIG_DS_COMPONENT_RESIZE=y
CONFIG_DS_USER_ROOT_EN=y
CONFIG_DS_PURGE_LOCALES=y
CONFIG_DS_HOSTNAME="tsimx28"
CONFIG_DS_TIMEZONE="America/Phoenix"
CONFIG_DS_IMAGE_ROOTFS_EXT=y
CONFIG_DS_IMAGE_ROOTFS_EXT_SIZE="1G"
CONFIG_DS_IMAGE_ROOTFS_EXT_MKFS_OPTS="-O ^metadata_csum,^64bit"
CONFIG_DS_GENIMAGE=y
CONFIG_DS_GENIMAGE_PATH="genimage/tsimx28_headless.cfg"
```

## configs/tsa38x_debian_12_headless_defconfig
```kconfig
CONFIG_DS_DISTRO_DEBIAN_12=y
CONFIG_DS_PACKAGELIST="debian_12_headless.txt"
CONFIG_DS_KERNEL_PROVIDER_GIT_URL="https://github.com/embeddedTS/linux-lts.git"
CONFIG_DS_KERNEL_PROVIDER_GIT_VERSION="v6.6.83.1-ts"
CONFIG_DS_KERNEL_DEFCONFIG="tsa38x_defconfig"
CONFIG_DS_KERNEL_INSTALL_DEVICETREE_FILESYSTEM="armada-385-ts7800-v2 armada-385-ts7840"
CONFIG_DS_KERNEL_INSTALL_ZIMAGE_FILESYSTEM=y
CONFIG_DS_COMPONENT_WILC3000_FIRMWARE=y
CONFIG_DS_MODULE_WILC3000=y
CONFIG_DS_MODULE_WILC3000_GIT_VERSION="2024.04-with-community-patches"
CONFIG_DS_COMPONENT_DISTROBOOT_SCRIPTS=y
CONFIG_DS_WATCHDOG=y
CONFIG_DS_COMPONENT_RESIZE=y
CONFIG_DS_COMPONENT_IDLEINJECT=y
CONFIG_DS_USER_ROOT_EN=y
CONFIG_DS_PURGE_LOCALES=y
CONFIG_DS_HOSTNAME="tsa38x"
# CONFIG_DS_REGENERATE_COMMAND_NOT_FOUND is not set
# CONFIG_DS_USE_NTPSERVER is not set
CONFIG_DS_IMAGE_ROOTFS_TAR=y
```

## configs/tsa38x_ubuntu_24_04_headless_defconfig
```kconfig
CONFIG_DS_DISTRO_UBUNTU_24_04=y
CONFIG_DS_PACKAGELIST="ubuntu_24.04_headless.txt"
CONFIG_DS_KERNEL_PROVIDER_GIT_URL="https://github.com/embeddedTS/linux-lts.git"
CONFIG_DS_KERNEL_PROVIDER_GIT_VERSION="v6.6.78.1-ts"
CONFIG_DS_KERNEL_DEFCONFIG="tsa38x_defconfig"
CONFIG_DS_KERNEL_INSTALL_DEVICETREE_FILESYSTEM="armada-385-ts7800-v2 armada-385-ts7840"
CONFIG_DS_KERNEL_INSTALL_ZIMAGE_FILESYSTEM=y
CONFIG_DS_COMPONENT_WILC3000_FIRMWARE=y
CONFIG_DS_MODULE_WILC3000=y
CONFIG_DS_MODULE_WILC3000_GIT_VERSION="2024.04-with-community-patches"
CONFIG_DS_WATCHDOG=y
CONFIG_DS_COMPONENT_RESIZE=y
CONFIG_DS_COMPONENT_IDLEINJECT=y
CONFIG_DS_USER=y
CONFIG_DS_USER_PASSWORD="user"
CONFIG_DS_USER_SUDO=y
CONFIG_DS_PURGE_LOCALES=y
CONFIG_DS_HOSTNAME="tsa38x"
CONFIG_DS_TIMEZONE="America/Phoenix"
CONFIG_DS_IMAGE_ROOTFS_TAR=y
```

## configs/tsimx9_debian_12_headless_defconfig
```kconfig
CONFIG_DS_ARCH_AARCH64=y
CONFIG_DS_DISTRO_DEBIAN_12=y
CONFIG_DS_PACKAGELIST="debian_12_headless.txt"
CONFIG_DS_KERNEL_PROVIDER_GIT_URL="https://github.com/embeddedTS/prototype-linux-imx93.git"
CONFIG_DS_KERNEL_PROVIDER_GIT_VERSION="31f8f698e5e85c8181108e52b2a3b3a1020029cf"
CONFIG_DS_KERNEL_DEFCONFIG="ts9370_defconfig"
CONFIG_DS_KERNEL_INSTALL_DEVICETREE_FILESYSTEM="freescale/imx93-ts4300 freescale/imx93-ts9370 freescale/imx93-ts9390"
CONFIG_DS_KERNEL_INSTALL_DTBOS_FILESYSTEM="freescale/imx93-ts4300-16 freescale/imx93-ts4300-16-mipi2dp"
CONFIG_DS_COMPONENT_TSSUPERVISORUPDATE=y
CONFIG_DS_COMPONENT_TS_UBOOT_CONFIGS=y
CONFIG_DS_MODULE_MWIFIEX=y
CONFIG_DS_MODULE_MWIFIEX_GIT_VERSION="lf-6.6.52_2.2.0"
CONFIG_DS_COMPONENT_IMX_FIRMWARE=y
CONFIG_DS_COMPONENT_IMX_FIRMWARE_GIT_VERSION="lf-6.6.52_2.2.0"
CONFIG_DS_COMPONENT_MURATA_NXP_LINUX_CALIBRATION=y
CONFIG_DS_COMPONENT_MURATA_NXP_LINUX_CALIBRATION_GIT_VERSION="imx-6-6-23"
CONFIG_DS_COMPONENT_LINUX_FIRMWARE=y
CONFIG_DS_COMPONENT_LINUX_FIRMWARE_QCA9377=y
CONFIG_DS_COMPONENT_DISTROBOOT_SCRIPTS=y
CONFIG_DS_COMPONENT_DISTROBOOT_EXTENSION=y
CONFIG_DS_COMPONENT_DISTROBOOT_SCRIPTS_INSTALL_SOURCE=y
CONFIG_DS_WATCHDOG=y
CONFIG_DS_COMPONENT_RESIZE=y
CONFIG_DS_USER_ROOT_EN=y
CONFIG_DS_PURGE_LOCALES=y
CONFIG_DS_HOSTNAME="tsimx9"
CONFIG_DS_TIMEZONE="America/Phoenix"
CONFIG_DS_DOWNGRADE_WPA_HOSTAPD=y
CONFIG_DS_IMAGE_ROOTFS_TAR=y
```

## configs/tsimx9_debian_12_minimal_defconfig
```kconfig
CONFIG_DS_ARCH_AARCH64=y
CONFIG_DS_DISTRO_DEBIAN_12=y
CONFIG_DS_PACKAGELIST="debian_12_minimal.txt"
CONFIG_DS_KERNEL_PROVIDER_GIT_URL="git@github.com:embeddedTS/prototype-linux-imx93.git"
CONFIG_DS_KERNEL_PROVIDER_GIT_VERSION="4be663a4f3305d3ecc1bde10cf7b08b602e23410"
CONFIG_DS_KERNEL_DEFCONFIG="ts9370_defconfig"
CONFIG_DS_KERNEL_INSTALL_DEVICETREE_FILESYSTEM="freescale/imx93-ts4300-16 freescale/imx93-ts4300-16-ts-rd-mipi2dp freescale/imx93-ts4300-16-ts-rd-mipi2dp-ti freescale/imx93-ts4300 freescale/imx93-ts9370 freescale/imx93-ts9390"
CONFIG_DS_COMPONENT_LINUX_FIRMWARE=y
CONFIG_DS_COMPONENT_LINUX_FIRMWARE_QCA9377=y
CONFIG_DS_COMPONENT_DISTROBOOT_SCRIPTS=y
CONFIG_DS_COMPONENT_DISTROBOOT_SCRIPTS_INSTALL_SOURCE=y
CONFIG_DS_WATCHDOG=y
CONFIG_DS_COMPONENT_RESIZE=y
CONFIG_DS_USER_ROOT_EN=y
CONFIG_DS_PURGE_LOCALES=y
CONFIG_DS_HOSTNAME="tsimx9"
CONFIG_DS_TIMEZONE="America/Phoenix"
CONFIG_DS_IMAGE_ROOTFS_TAR=y
```

## configs/tsimx9_debian_12_x11_defconfig
```kconfig
CONFIG_DS_ARCH_AARCH64=y
CONFIG_DS_DISTRO_DEBIAN_12=y
CONFIG_DS_PACKAGELIST="debian_12_x11.txt"
CONFIG_DS_KERNEL_PROVIDER_GIT_URL="git@github.com:embeddedTS/prototype-linux-imx93.git"
CONFIG_DS_KERNEL_PROVIDER_GIT_VERSION="26e87b10a9e98e7540d9e98ed90a1941b7da2291"
CONFIG_DS_KERNEL_DEFCONFIG="ts9370_defconfig"
CONFIG_DS_KERNEL_INSTALL_DEVICETREE_FILESYSTEM="freescale/imx93-ts4300-16 freescale/imx93-ts4300-16-ts-rd-mipi2dp freescale/imx93-ts4300-16-ts-rd-mipi2dp-ti freescale/imx93-ts4300 freescale/imx93-ts9370 freescale/imx93-ts9390"
CONFIG_DS_COMPONENT_TSSUPERVISORUPDATE=y
CONFIG_DS_COMPONENT_TS_TOUCHSCREEN_CALIBRATIONS=y
CONFIG_DS_COMPONENT_TS_X11_CALIBRATION=y
CONFIG_DS_COMPONENT_TS_UBOOT_CONFIGS=y
CONFIG_DS_COMPONENT_LINUX_FIRMWARE=y
CONFIG_DS_COMPONENT_LINUX_FIRMWARE_QCA9377=y
CONFIG_DS_COMPONENT_DISTROBOOT_SCRIPTS=y
CONFIG_DS_COMPONENT_DISTROBOOT_SCRIPTS_INSTALL_SOURCE=y
CONFIG_DS_WATCHDOG=y
CONFIG_DS_COMPONENT_RESIZE=y
CONFIG_DS_XORG_STARTX_SERVICE=y
CONFIG_DS_USER_ROOT_EN=y
CONFIG_DS_PURGE_LOCALES=y
CONFIG_DS_HOSTNAME="tsimx9"
CONFIG_DS_TIMEZONE="America/Phoenix"
CONFIG_DS_DOWNGRADE_WPA_HOSTAPD=y
CONFIG_DS_IMAGE_ROOTFS_TAR=y
```

## configs/tsimx9_debian_13_minimal_defconfig
```kconfig
CONFIG_DS_ARCH_AARCH64=y
CONFIG_DS_DISTRO_DEBIAN_13=y
CONFIG_DS_PACKAGELIST="debian_13_minimal.txt"
CONFIG_DS_KERNEL_PROVIDER_GIT_URL="https://github.com/embeddedTS/linux-tsimx.git"
CONFIG_DS_KERNEL_PROVIDER_GIT_VERSION="f84de336d25c856f2365ba201a73cc593c198fe0"
CONFIG_DS_KERNEL_DEFCONFIG="tsimx93_defconfig"
CONFIG_DS_KERNEL_INSTALL_DEVICETREE_FILESYSTEM="freescale/imx93-ts4300 freescale/imx93-ts9370 freescale/imx93-ts9390"
CONFIG_DS_KERNEL_INSTALL_DTBOS_FILESYSTEM="freescale/imx93-ts4300-16 freescale/imx93-ts4300-16-mipi2dp freescale/imx93-ts4300-ld"
CONFIG_DS_COMPONENT_TSSUPERVISORUPDATE=y
CONFIG_DS_COMPONENT_TS_UBOOT_CONFIGS=y
CONFIG_DS_MODULE_MWIFIEX=y
CONFIG_DS_MODULE_MWIFIEX_GIT_VERSION="lf-6.12.34_2.1.0"
CONFIG_DS_COMPONENT_IMX_FIRMWARE=y
CONFIG_DS_COMPONENT_IMX_FIRMWARE_GIT_VERSION="lf-6.12.34_2.1.0"
CONFIG_DS_COMPONENT_MURATA_NXP_LINUX_CALIBRATION=y
CONFIG_DS_COMPONENT_MURATA_NXP_LINUX_CALIBRATION_GIT_VERSION="imx-6-12-20"
CONFIG_DS_COMPONENT_LINUX_FIRMWARE=y
CONFIG_DS_COMPONENT_LINUX_FIRMWARE_QCA9377=y
CONFIG_DS_COMPONENT_DISTROBOOT_SCRIPTS=y
CONFIG_DS_COMPONENT_DISTROBOOT_EXTENSION=y
CONFIG_DS_WATCHDOG=y
CONFIG_DS_COMPONENT_RESIZE=y
CONFIG_DS_USER_ROOT_EN=y
CONFIG_DS_PURGE_LOCALES=y
CONFIG_DS_HOSTNAME="tsimx9"
CONFIG_DS_TIMEZONE="America/Phoenix"
# CONFIG_DS_REGENERATE_COMMAND_NOT_FOUND is not set
CONFIG_DS_IMAGE_ROOTFS_TAR=y
```

## configs/tsimx9_ubuntu_24_04_minimal_defconfig
```kconfig
CONFIG_DS_ARCH_AARCH64=y
CONFIG_DS_DISTRO_UBUNTU_24_04=y
CONFIG_DS_PACKAGELIST="ubuntu_24.04_headless.txt"
CONFIG_DS_KERNEL_PROVIDER_GIT_URL="https://github.com/embeddedTS/linux-tsimx.git"
CONFIG_DS_KERNEL_PROVIDER_GIT_VERSION="08074a5eeea4c9ce677d181d1bcf14da0a2d4d7d"
CONFIG_DS_KERNEL_DEFCONFIG="tsimx93_defconfig"
CONFIG_DS_KERNEL_INSTALL_DEVICETREE_FILESYSTEM="freescale/imx93-ts4300 freescale/imx93-ts9370 freescale/imx93-ts9390"
CONFIG_DS_KERNEL_INSTALL_DTBOS_FILESYSTEM="freescale/imx93-ts4300-16 freescale/imx93-ts4300-16-mipi2dp"
CONFIG_DS_COMPONENT_TSSUPERVISORUPDATE=y
CONFIG_DS_COMPONENT_TS_TOUCHSCREEN_CALIBRATIONS=y
CONFIG_DS_COMPONENT_TS_X11_CALIBRATION=y
CONFIG_DS_COMPONENT_TS_UBOOT_CONFIGS=y
CONFIG_DS_MODULE_MWIFIEX=y
CONFIG_DS_MODULE_MWIFIEX_GIT_VERSION="lf-6.12.34_2.1.0"
CONFIG_DS_COMPONENT_IMX_FIRMWARE=y
CONFIG_DS_COMPONENT_IMX_FIRMWARE_GIT_VERSION="lf-6.12.34_2.1.0"
CONFIG_DS_COMPONENT_MURATA_NXP_LINUX_CALIBRATION=y
CONFIG_DS_COMPONENT_MURATA_NXP_LINUX_CALIBRATION_GIT_VERSION="imx-6-12-20"
CONFIG_DS_COMPONENT_LINUX_FIRMWARE=y
CONFIG_DS_COMPONENT_DISTROBOOT_SCRIPTS=y
CONFIG_DS_COMPONENT_DISTROBOOT_EXTENSION=y
CONFIG_DS_COMPONENT_DISTROBOOT_SCRIPTS_INSTALL_SOURCE=y
CONFIG_DS_WATCHDOG=y
CONFIG_DS_COMPONENT_RESIZE=y
CONFIG_DS_USER=y
CONFIG_DS_USER_PASSWORD="user"
CONFIG_DS_USER_SUDO=y
CONFIG_DS_PURGE_LOCALES=y
CONFIG_DS_HOSTNAME="tsimx9"
CONFIG_DS_TIMEZONE="America/Phoenix"
# CONFIG_DS_REGENERATE_COMMAND_NOT_FOUND is not set
CONFIG_DS_IMAGE_ROOTFS_TAR=y
```

## tasks/components/alsa-ucm-conf/Kconfig
```kconfig
config DS_COMPONENT_ALSA_UCM_CONF
	bool "alsa-ucm-conf for audio configuration"
	help
	  Alsa Use Case Manager configuration files for embeddedTS devices.
```

## tasks/components/distroboot-scripts/Kconfig
```kconfig
config DS_COMPONENT_DISTROBOOT_SCRIPTS
	bool "Install distroboot compatible /boot/boot.scr script"
	help
	  For newer U-Boots with distroboot a valid /boot/boot.scr script
	  is needed to boot the system.

config DS_COMPONENT_DISTROBOOT_EXTENSION
	bool "Enable extension support in boot/boot.scr script"
	depends on DS_COMPONENT_DISTROBOOT_SCRIPTS
	help
	  For newer u-boots, this supports automatically applying device tree overlays
	  using u-boot's "extension" command.

config DS_COMPONENT_DISTROBOOT_SCRIPTS_INSTALL_SOURCE
	bool "Install distroboot script source file to /boot/boot.source"
	depends on DS_COMPONENT_DISTROBOOT_SCRIPTS
	help
	  Install the distroboot script source to the image. This can be used to
	  change the script on the unit itself
```

## tasks/components/embeddedts-apt-repo/Kconfig
```kconfig
config DS_COMPONENT_EMBEDDEDTS_APT_REPO
	bool "embeddedTS APT repository"
	help
	  Enable access to embeddedTS's apt repistory and packages
```

## tasks/components/gps+pps/Kconfig
```kconfig
config DS_COMPONENT_GPSD_PPS
	bool "Install gpsd and pps-related packages and an embeddedTS platform-specific gpsd.config file"
	help
	  Installs gpsd and pps-related packages that enable location
          as well as embeddedTS's configuration files for GPS-based
          timekeeping.
```

## tasks/components/idleinject/Kconfig
```kconfig
config DS_COMPONENT_IDLEINJECT
	bool "idleinject"
	help
          This tool is used to inject idle from userspace to cool systems that do not
          support kernel based idle injection or throttling.
```

## tasks/components/imx-firmware/Kconfig
```kconfig
config DS_COMPONENT_IMX_FIRMWARE
	bool "imx-firmware for wifi modules"
	help
	  Installs NXP IMX Firmware

config DS_COMPONENT_IMX_FIRMWARE_GIT_VERSION
	depends on DS_COMPONENT_IMX_FIRMWARE
	string "imx-firmware GIT srcrev"
	help
	  Specify tag or branch to checkout before installing

# The way the driver expects firmare at this time, it is mutually exclusive
# and only one can be populated at /lib/firmare/nxp/ at a time
choice
	depends on DS_COMPONENT_IMX_FIRMWARE
	prompt "Select WIFI firmware from imx-firmware"
	help
	  Choose one of the supported firmware variants for the IW612 module.

config DS_COMPONENT_IMX_FIRMWARE_IW612_SD
	bool "IW612_SD Firmware"
	help
	  Installs firmware for IW612_SD wifi/bt module

endchoice
```

## tasks/components/linux-firmware/Kconfig
```kconfig
config DS_COMPONENT_LINUX_FIRMWARE
	bool "linux-firmware"
	help
	  Allows installing firmware files from linux-firmware git

config DS_COMPONENT_LINUX_FIRMWARE_QCA9377
	bool "Installs QCA9377 Firmware Files"
	depends on DS_COMPONENT_LINUX_FIRMWARE
	help
	  Installs support for QCA9377 based devices

config DS_COMPONENT_LINUX_FIRMWARE_GIT_VERSION
	string "linux-firmware GIT srcrev"
	depends on DS_COMPONENT_LINUX_FIRMWARE
	default "20230804"
	help
	  Specify tag or branch to checkout before installing firmware files.
```

## tasks/components/murata-nxp-linux-calibration/Kconfig
```kconfig
config DS_COMPONENT_MURATA_NXP_LINUX_CALIBRATION
	bool "Murata NXP WIFI Calibration firmware"
	help
	  Installs Murata NXP Calibration Firmware

config DS_COMPONENT_MURATA_NXP_LINUX_CALIBRATION_GIT_VERSION
	depends on DS_COMPONENT_MURATA_NXP_LINUX_CALIBRATION
	string "Murata NXP WIFI Calibration firmware GIT srcrev"
	help
	  Specify tag or branch to checkout before building.

choice
	depends on DS_COMPONENT_MURATA_NXP_LINUX_CALIBRATION
	prompt "Select Murata module"
	help
	  Choose one of the supported firmware variants for the IW612 module.

config DS_COMPONENT_MURATA_NXP_LINUX_CALIBRATION_2DL
	depends on DS_COMPONENT_MURATA_NXP_LINUX_CALIBRATION
	bool "Type 2DL Firmware"
	help
	  Installs calibration for type 2DL module

endchoice

choice
	depends on DS_COMPONENT_MURATA_NXP_LINUX_CALIBRATION
	prompt "Select country code for firmware"
	help
	  Choose one of the supported firmware variants for the IW612 module.

config DS_COMPONENT_MURATA_NXP_LINUX_CALIBRATION_2DL_US
	bool "US"
	help
	  Installs US calibration values

config DS_COMPONENT_MURATA_NXP_LINUX_CALIBRATION_2DL_EU
	bool "EU"
	help
	  Installs US calibration values

config DS_COMPONENT_MURATA_NXP_LINUX_CALIBRATION_2DL_JP
	bool "JP"
	help
	  Installs US calibration values

config DS_COMPONENT_MURATA_NXP_LINUX_CALIBRATION_2DL_CA
	bool "CA"
	help
	  Installs US calibration values

endchoice
```
